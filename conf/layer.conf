## conf/layer.conf
```bitbake
# We have a conf and classes directory, add to BBPATH
BBPATH .= ":${LAYERDIR}"

# We have recipes-* directories, add to BBFILES
BBFILES += "${LAYERDIR}/recipes-*/*/*.bb \
            ${LAYERDIR}/recipes-*/*/*.bbappend"

BBFILE_COLLECTIONS += "meta-vinci-energies"
BBFILE_PATTERN_meta-vinci-energies = "^${LAYERDIR}/"
BBFILE_PRIORITY_meta-vinci-energies = "6"

LAYERDEPENDS_meta-vinci-energies = "core"
LAYERSERIES_COMPAT_meta-vinci-energies = "sumo warrior zeus dunfell hardknott"
```
